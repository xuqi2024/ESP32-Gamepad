## sdkconfig.defaults
```kconfig
# 蓝牙配置
CONFIG_BT_ENABLED=y
CONFIG_BT_BLUEDROID_ENABLED=y
CONFIG_BT_CLASSIC_ENABLED=y
CONFIG_BT_HID_HOST_ENABLED=y
CONFIG_BT_HID_ENABLED=y

# HID主机配置
CONFIG_BT_BLUEDROID_HID_HOST_ENABLED=y

# 蓝牙控制器配置
CONFIG_BT_CONTROLLER_ENABLED=y
CONFIG_BT_CONTROLLER_ONLY=n

# 日志级别
CONFIG_LOG_DEFAULT_LEVEL_INFO=y

# FreeRTOS配置
CONFIG_FREERTOS_HZ=1000

# 内存优化
CONFIG_ESP32_WIFI_STATIC_RX_BUFFER_NUM=4
CONFIG_ESP32_WIFI_DYNAMIC_RX_BUFFER_NUM=8

# 串口配置
CONFIG_ESP_CONSOLE_UART_DEFAULT=y
CONFIG_ESP_CONSOLE_UART_BAUDRATE_115200=y

# 组件配置
CONFIG_ESP_TIMER_TASK_STACK_SIZE=4096
```
